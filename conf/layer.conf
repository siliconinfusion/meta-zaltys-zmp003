## conf/layer.conf
```bitbake
# We have a conf and classes directory, add to BBPATH
BBPATH .= ":${LAYERDIR}"

# We have recipes-* directories, add to BBFILES
BBFILES += "${LAYERDIR}/recipes-*/*/*.bb \
            ${LAYERDIR}/recipes-*/*/*.bbappend"

BBFILE_COLLECTIONS += "zaltys-zmp003"
BBFILE_PATTERN_zaltys-zmp003 = "^${LAYERDIR}/"
BBFILE_PRIORITY_zaltys-zmp003 = "6"
LAYERVERSION_zaltys-zmp003 = "1"

LAYERDEPENDS_zaltys-zmp003 = "fsl-arm"

# Don't attempt to build the ptpd package -- there are do_compile errors
RDEPENDS_packagegroup-fsl-tools-testapps_remove_imx6qzmp003 = "ptpd"
```

## conf/machine/imx6qzmp003.conf
```bitbake
#@TYPE: Machine
#@NAME: Zaltys ZMP003 i.MX6Q CPU Card
#@SOC: i.MX6Q
#@DESCRIPTION: Machine configuration for Zaltys ZMP003 i.MX6Q CPU Card
#@MAINTAINER: Chris Holgate <chris@zynaptic.com>

SOC_FAMILY = "mx6:mx6q"

require conf/machine/include/imx-base.inc
require conf/machine/include/tune-cortexa9.inc

SERIAL_CONSOLE = "115200 ttymxc3"

MACHINE_FEATURES += " pci"

KERNEL_DEVICETREE = "imx6q-zmp003-hdmi.dtb imx6q-zmp003-lcd.dtb imx6q-zmp003-dual.dtb"

IMX6QZMP003_UBOOT_TARGET ?= "MX6QZMP003-4GB-HDMI"

UBOOT_CONFIG[sd] = "${IMX6QZMP003_UBOOT_TARGET}_config,sdcard"
UBOOT_CONFIG[sata] = "${IMX6QZMP003_UBOOT_TARGET}_sata_config"
UBOOT_CONFIG[mfgtool] = "${IMX6QZMP003_UBOOT_TARGET}_config"

UBOOT_CONFIG ??= "sd"
```
